## slim_diamond/zmk/boards/shields/slim_diamond_trackball/Kconfig.defconfig
```kconfig
# SPDX-License-Identifier: MIT

if SHIELD_SLIM_DIAMOND_TRACKBALL

config ZMK_KEYBOARD_NAME
    default "SD Trackball"

endif
```

## slim_diamond/zmk/boards/shields/slim_diamond_trackball/Kconfig.shield
```kconfig
# SPDX-License-Identifier: MIT

config SHIELD_SLIM_DIAMOND_TRACKBALL
    def_bool $(shields_list_contains,slim_diamond_trackball)
```

## slim_diamond/zmk/boards/shields/slim_diamond_trackball_xiao/Kconfig.defconfig
```kconfig
# SPDX-License-Identifier: MIT

if SHIELD_SLIM_DIAMOND_TRACKBALL_XIAO

config ZMK_KEYBOARD_NAME
    default "SD Trackball"

endif
```

## slim_diamond/zmk/boards/shields/slim_diamond_trackball_xiao/Kconfig.shield
```kconfig
# SPDX-License-Identifier: MIT

config SHIELD_SLIM_DIAMOND_TRACKBALL_XIAO
    def_bool $(shields_list_contains,slim_diamond_trackball_xiao)
```

## slim_diamond/zmk/boards/shields/slim_diamond_trackpad/Kconfig.defconfig
```kconfig
# SPDX-License-Identifier: MIT

if SHIELD_SLIM_DIAMOND_TRACKPAD

config ZMK_KEYBOARD_NAME
    default "SD Trackpad"

endif
```

## slim_diamond/zmk/boards/shields/slim_diamond_trackpad/Kconfig.shield
```kconfig
# SPDX-License-Identifier: MIT

config SHIELD_SLIM_DIAMOND_TRACKPAD
    def_bool $(shields_list_contains,slim_diamond_trackpad)
```

## slim_diamond/zmk/boards/shields/slim_diamond_trackpad_xiao/Kconfig.defconfig
```kconfig
# SPDX-License-Identifier: MIT

if SHIELD_SLIM_DIAMOND_TRACKPAD_XIAO

config ZMK_KEYBOARD_NAME
    default "SD Trackpad"

endif
```

## slim_diamond/zmk/boards/shields/slim_diamond_trackpad_xiao/Kconfig.shield
```kconfig
# SPDX-License-Identifier: MIT

config SHIELD_SLIM_DIAMOND_TRACKPAD_XIAO
    def_bool $(shields_list_contains,slim_diamond_trackpad_xiao)
```
